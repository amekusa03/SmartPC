## sdkconfig.defaults
```kconfig
CONFIG_IDF_TARGET="esp32s3"
CONFIG_ESPTOOLPY_FLASHSIZE_4MB=y

# Bluetooth / NimBLE for Commissioning
CONFIG_BT_ENABLED=y
CONFIG_BT_NIMBLE_ENABLED=y
CONFIG_BT_NIMBLE_ENABLE_CONN_REATTEMPT=n

# LwIP IPv6
CONFIG_LWIP_IPV6_AUTOCONFIG=y
CONFIG_LWIP_HOOK_IP6_ROUTE_DEFAULT=y
CONFIG_LWIP_HOOK_ND6_GET_GW_DEFAULT=y
CONFIG_LWIP_IPV6_NUM_ADDRESSES=6

# Partition Table
CONFIG_PARTITION_TABLE_CUSTOM=y
CONFIG_PARTITION_TABLE_FILENAME="partitions.csv"
CONFIG_PARTITION_TABLE_OFFSET=0xC000

# Wi-Fi SoftAP disabled for Matter over Wi-Fi
CONFIG_ENABLE_WIFI_AP=n
CONFIG_ESP_WIFI_SOFTAP_SUPPORT=n

# Matter & Security
CONFIG_ENABLE_CHIP_SHELL=n
CONFIG_ENABLE_OTA_REQUESTOR=y
CONFIG_MBEDTLS_HKDF_C=y
CONFIG_ESP_MATTER_MAX_DYNAMIC_ENDPOINT_COUNT=2

# TinyUSB HID
CONFIG_TINYUSB_HID_COUNT=1
# TinyUSB CDC Configuration
CONFIG_TINYUSB_CDC_ENABLED=y
CONFIG_TINYUSB_CDC_COUNT=1
CONFIG_ESP_CONSOLE_USB_CDC=y
CONFIG_ESP_CONSOLE_SECONDARY_NONE=y
```
